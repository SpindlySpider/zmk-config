## boards/shields/spindly-board/Kconfig.defconfig
```kconfig
if SHEILD_SPINDLY_BOARD

config ZMK_KEYBOARD_NAME
  default "spindly-board"

config ZMK_USB
    default y

endif
```

## config/west.yml
```yaml
manifest:
  remotes:
    - name: zmkfirmware
      url-base: https://github.com/petejohanson
    # START #####
    - name: badjeff
      url-base: https://github.com/badjeff
    # END #######
  projects:
    - name: zmk
      remote: zmkfirmware
      revision: feat/pointers-move-scroll
      import: app/west.yml
    # START #####
    - name: zmk-pmw3610-driver
      remote: badjeff
      revision: main
    # END #######
  self:
    path: config
```
