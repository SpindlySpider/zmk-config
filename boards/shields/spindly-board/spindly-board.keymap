#include <behaviors.dtsi>
#include <dt-bindings/zmk/keys.h>
#include <dt-bindings/zmk/bt.h>
#include <dt-bindings/zmk/pointing.h>
#include <input/processors.dtsi>

/{
  keymap{
    compatible = "zmk,keymap";

    default_layer {
      bindings = <
      &kp A
      >;
    };
  };
};
